## apps/examples/fhre_demo/base/Kconfig
```kconfig
config EXAMPLES_FHRE_DEMO
	bool "FHRE framebuffer drawing demo"
	default n
	depends on FHRE
	depends on VIDEO_FB
	---help---
		Enable the FHRE demo command. It runs from NSH as fhre_demo.
```

## apps/examples/fhre_demo/clang/Kconfig
```kconfig
config EXAMPLES_FHRE_DEMO_CLANG
	bool "FHRE demo in clang"
	default n
	depends on EXAMPLES_FHRE_DEMO
	select FHRE_CLANG
	---help---
		Reserved for the parallel clang/C FHRE demo.
```

## apps/examples/fhre_demo/rust/Kconfig
```kconfig
config EXAMPLES_FHRE_DEMO_RUST
	bool "FHRE demo in Rust"
	default y if EXAMPLES_FHRE_DEMO
	depends on EXAMPLES_FHRE_DEMO
	select FHRE_RUST
	---help---
		Rust-first FHRE demo.  It is no_std and uses no external Rust
		crates.

if EXAMPLES_FHRE_DEMO_RUST

config EXAMPLES_FHRE_DEMO_RUST_PROGNAME
	string "Program name"
	default "fhre_demo"

config EXAMPLES_FHRE_DEMO_RUST_PRIORITY
	int "FHRE demo task priority"
	default 100

config EXAMPLES_FHRE_DEMO_RUST_STACKSIZE
	int "FHRE demo stack size"
	default 8192

endif
```

## apps/examples/wing_demo/base/Kconfig
```kconfig
config EXAMPLES_WING_DEMO
	bool "Wing UI shell demo"
	default n
	depends on WING
	depends on VIDEO_FB
	---help---
		Enable the Wing UI demo command. It runs from NSH as wing_demo.
```

## apps/examples/wing_demo/clang/Kconfig
```kconfig
config EXAMPLES_WING_DEMO_CLANG
	bool "Wing demo in clang"
	default n
	depends on EXAMPLES_WING_DEMO
	select WING_CLANG
	---help---
		Reserved for the parallel clang/C Wing demo.
```

## apps/examples/wing_demo/rust/Kconfig
```kconfig
config EXAMPLES_WING_DEMO_RUST
	bool "Wing demo in Rust"
	default y if EXAMPLES_WING_DEMO
	depends on EXAMPLES_WING_DEMO
	select WING_RUST
	---help---
		Rust-first Wing UI demo. It is independent from the FHRE
		rendering demo and registers only wing_demo.

if EXAMPLES_WING_DEMO_RUST

config EXAMPLES_WING_DEMO_RUST_PROGNAME
	string "Program name"
	default "wing_demo"

config EXAMPLES_WING_DEMO_RUST_PRIORITY
	int "Wing demo task priority"
	default 100

config EXAMPLES_WING_DEMO_RUST_STACKSIZE
	int "Wing demo stack size"
	default 32768

endif
```
