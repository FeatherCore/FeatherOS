## nuttx/arch/arm/src/stm32n6/Kconfig
```kconfig
#
# For a description of the syntax of this configuration file, see
# the file kconfig-language.txt in the NuttX tools repository.
#

if ARCH_CHIP_STM32N6

comment "STM32N6 Configuration Options"

choice
	prompt "STM32N6 Chip Selection"
	default ARCH_CHIP_STM32N657XX

config ARCH_CHIP_STM32N657XX
	bool "STM32N657xx"
	select ARCH_CORTEXM55
	select ARCH_HAVE_FPU
	select ARCH_HAVE_MPU
	select ARCH_HAVE_IRQPRIO
	select ARCH_HAVE_IRQTRIGGER
	select ARMV8M_HAVE_ICACHE
	select ARMV8M_HAVE_DCACHE
	select ARMV8M_SYSTICK
	select ARM_HAVE_DSP
	select ARM_HAVE_MVE
	select ARM_HAVE_MPU_UNIFIED
	---help---
		STMicro STM32N657xx Cortex-M55 devices.

endchoice

comment "STM32N6 Core"

config STM32N6_NPU
	bool "Neural-ART NPU"
	default n

config STM32N6_NPU_CACHE
	bool "NPU CACHEAXI"
	default n
	depends on STM32N6_NPU

config STM32N6_RIF
	bool "Resource Isolation Framework"
	default n

config STM32N6_RIF_OPEN
	bool "Open RIF resources during early bring-up"
	default n
	depends on STM32N6_RIF

comment "STM32N6 Peripheral Selection"

config STM32N6_GPIO
	bool "GPIO"
	default y

config STM32N6_USART
	bool
	default n

menu "STM32N6 U[S]ART Selection"

config STM32N6_USART1
	bool "USART1"
	default n
	select ARCH_HAVE_SERIAL_TERMIOS
	select STM32N6_USART
	select USART1_SERIALDRIVER

config STM32N6_USART2
	bool "USART2"
	default n
	select ARCH_HAVE_SERIAL_TERMIOS
	select STM32N6_USART
	select USART2_SERIALDRIVER

config STM32N6_USART3
	bool "USART3"
	default n
	select ARCH_HAVE_SERIAL_TERMIOS
	select STM32N6_USART
	select USART3_SERIALDRIVER

config STM32N6_UART4
	bool "UART4"
	default n
	select ARCH_HAVE_SERIAL_TERMIOS
	select STM32N6_USART
	select UART4_SERIALDRIVER

config STM32N6_UART5
	bool "UART5"
	default n
	select ARCH_HAVE_SERIAL_TERMIOS
	select STM32N6_USART
	select UART5_SERIALDRIVER

config STM32N6_USART6
	bool "USART6"
	default n
	select ARCH_HAVE_SERIAL_TERMIOS
	select STM32N6_USART
	select USART6_SERIALDRIVER

endmenu

config STM32N6_I2C
	bool
	default n

config STM32N6_I2C1
	bool "I2C1"
	default n
	select STM32N6_I2C

config STM32N6_I2C2
	bool "I2C2"
	default n
	select STM32N6_I2C

config STM32N6_I2C4
	bool "I2C4"
	default n
	select STM32N6_I2C

config STM32N6_SPI
	bool
	default n

config STM32N6_SPI5
	bool "SPI5"
	default n
	select STM32N6_SPI

config STM32N6_FDCAN
	bool
	default n

config STM32N6_FDCAN1
	bool "FDCAN1"
	default n
	select STM32N6_FDCAN

config STM32N6_XSPI
	bool
	default n

config STM32N6_XSPI1
	bool "XSPI1"
	default n
	select STM32N6_XSPI

config STM32N6_XSPI2
	bool "XSPI2"
	default n
	select STM32N6_XSPI

config STM32N6_XSPI2_FLASH
	bool "XSPI2 Macronix MX66UW1G45G NOR Flash"
	default n
	depends on STM32N6_XSPI2
	select MTD
	select MTD_MX66UW
	---help---
		Enable the STM32N6570-DK external NOR FLASH on XSPI2 and
		register it as an MTD device during board bring-up.

config STM32N6_USB
	bool
	default n

config STM32N6_USBOTGHS1
	bool "USB OTG HS1"
	default n
	select STM32N6_USB

config STM32N6_ETH
	bool "Ethernet MAC"
	default n

config STM32N6_LTDC
	bool "LCD-TFT Display Controller"
	default n

config STM32N6_ADC
	bool
	default n

config STM32N6_ADC1
	bool "ADC1"
	default n
	select STM32N6_ADC

config STM32N6_TIMERS
	bool "TIM timers"
	default n

config STM32N6_PWM
	bool
	default n

config STM32N6_TIM1_PWM
	bool "TIM1 PWM"
	default n
	select STM32N6_PWM
	select STM32N6_TIMERS

config STM32N6_TIM15_PWM
	bool "TIM15 PWM"
	default n
	select STM32N6_PWM
	select STM32N6_TIMERS

config STM32N6_SDMMC
	bool
	default n

config STM32N6_SDMMC2
	bool "SDMMC2"
	default n
	select STM32N6_SDMMC

config STM32N6_DMA
	bool "DMA"
	default n

config STM32N6_EXTI
	bool "EXTI"
	default n

config STM32N6_HSEM
	bool "Hardware semaphore"
	default n

config STM32N6_LPTIM
	bool "Low-power timers"
	default n

config STM32N6_FLASH
	bool "Flash controller"
	default n

config STM32N6_PWR
	bool "Power controller"
	default n

config STM32N6_WWDG
	bool "Window watchdog"
	default n

config STM32N6_IWDG
	bool "Independent watchdog"
	default n

config STM32N6_JPEG
	bool "JPEG codec"
	default n

config STM32N6_VENC
	bool "Video encoder"
	default n

config STM32N6_DMA2D
	bool "DMA2D"
	default n
	depends on EXPERIMENTAL

config STM32N6_DCMIPP
	bool "DCMIPP"
	default n
	depends on EXPERIMENTAL

comment "STM32N6 Memory Configuration"

config STM32N6_AXISRAM1
	bool "AXISRAM1"
	default y

config STM32N6_AXISRAM2
	bool "AXISRAM2"
	default y

config STM32N6_AXISRAM3
	bool "AXISRAM3"
	default n

config STM32N6_AXISRAM4
	bool "AXISRAM4"
	default n

config STM32N6_AXISRAM5
	bool "AXISRAM5"
	default n

config STM32N6_AXISRAM6
	bool "AXISRAM6"
	default n

comment "STM32N6 Clock Configuration"

config STM32N6_HSI_FREQUENCY
	int "HSI frequency in Hz"
	default 64000000

config STM32N6_HSE_FREQUENCY
	int "HSE frequency in Hz"
	default 48000000

config STM32N6_LSI_FREQUENCY
	int "LSI frequency in Hz"
	default 32000

config STM32N6_LSE_FREQUENCY
	int "LSE frequency in Hz"
	default 32768

config STM32N6_HSE_BYPASS
	bool "HSE bypass"
	default n

config STM32N6_HSE_DIV2
	bool "HSE divided by 2"
	default n

config STM32N6_LSE_BYPASS
	bool "LSE bypass"
	default n

config STM32N6_LSE_DRIVING
	int "LSE driving capability"
	default 2
	range 0 3

choice
	prompt "PLL1 source clock"
	default STM32N6_PLL1SRC_HSI

config STM32N6_PLL1SRC_HSI
	bool "HSI"

config STM32N6_PLL1SRC_HSE
	bool "HSE"

config STM32N6_PLL1SRC_MSI
	bool "MSI"

endchoice

config STM32N6_PLL1_M
	int "PLL1 M divider"
	default 2
	range 1 63

config STM32N6_PLL1_N
	int "PLL1 N multiplier"
	default 100
	range 4 512

config STM32N6_PLL1_P1
	int "PLL1 P1 divider"
	default 2
	range 1 128

config STM32N6_PLL1_P2
	int "PLL1 P2 divider"
	default 2
	range 1 128

choice
	prompt "Voltage scaling"
	default STM32N6_VOS_SCALE0

config STM32N6_VOS_SCALE0
	bool "Scale 0"

config STM32N6_VOS_SCALE1
	bool "Scale 1"

config STM32N6_VOS_SCALE2
	bool "Scale 2"

endchoice

config STM32N6_VOS_SCALE
	int
	default 0 if STM32N6_VOS_SCALE0
	default 1 if STM32N6_VOS_SCALE1
	default 2 if STM32N6_VOS_SCALE2

config STM32N6_AHB_PRESCALER
	int "AHB prescaler"
	default 1
	range 1 512

config STM32N6_APB1_PRESCALER
	int "APB1 prescaler"
	default 1
	range 1 16

config STM32N6_APB2_PRESCALER
	int "APB2 prescaler"
	default 1
	range 1 16

config STM32N6_APB4_PRESCALER
	int "APB4 prescaler"
	default 1
	range 1 16

config STM32N6_APB5_PRESCALER
	int "APB5 prescaler"
	default 1
	range 1 16

config STM32N6_SYSCLK_FREQUENCY
	int "System clock frequency in Hz"
	default 64000000

config STM32N6_HCLK_FREQUENCY
	int "AHB clock frequency in Hz"
	default 64000000

endif
```

## nuttx/boards/arm/ra8p/ek-ra8p1/configs/nsh/defconfig
```kconfig
#
# For a description of the syntax of this configuration file,
# see the file kconfig-language.txt in the NuttX tools repository.
#

# Architecture Configuration
CONFIG_ARCH="arm"
CONFIG_ARCH_BOARD="ek-ra8p1"
CONFIG_ARCH_BOARD_CUSTOM=y
CONFIG_ARCH_CHIP="ra8p"
CONFIG_ARCH_CHIP_R7KA8P1KFLCAC=y
CONFIG_ARCH_CHIP_RA8P=y
CONFIG_ARCH_FPU=y
CONFIG_ARCH_DSP=y
CONFIG_ARCH_MVE=y
CONFIG_ARCH_MPU=y

# Board Configuration
CONFIG_ARCH_BOARD_SUBFAMILY="ra8p"
CONFIG_BOARD_LOOPSPERMSEC=200000
CONFIG_BOARDCTL=y

# Clock Configuration
CONFIG_RA8P_ICLK_FREQUENCY=200000000
CONFIG_RA8P_PCLKA_FREQUENCY=100000000
CONFIG_RA8P_PCLKB_FREQUENCY=50000000

# Console Configuration
CONFIG_CONSOLE_SYSLOG=y
CONFIG_SYSLOG_DEVPATH="/dev/console"
CONFIG_RTT_CONSOLE=y
CONFIG_RTT_CONSOLE_DEVNUM=2

# Serial Configuration
CONFIG_SCIF_SERIAL_CONSOLE=y
CONFIG_SCIF0_SERIAL=n
CONFIG_SCIF1_SERIAL=n
CONFIG_SCIF2_SERIAL=y
CONFIG_RA8P_SCI_B_UART2=y
CONFIG_RA8P_SCI_B_UART0=n
CONFIG_RA8P_SCI_B_UART1=n
CONFIG_RA8P_SCI_B_UART3=n
CONFIG_RA8P_SCI_B_UART4=n

# Debug Configuration
CONFIG_DEBUG_FEATURES=y
CONFIG_DEBUG_INFO=y
CONFIG_DEBUG_ERROR=y
CONFIG_DEBUG_WARN=y
CONFIG_DEBUG_SERIAL=y

# Memory Configuration
CONFIG_MM_REGIONS=4
CONFIG_ARCH_ADDRENV=y
CONFIG_MM_KERNEL_HEAP=y
CONFIG_HEAP2_BASE=0x22010000
CONFIG_HEAP2_SIZE=0x100000

# Built-in Application Configuration
CONFIG_BUILTIN=y
CONFIG_NSH_BUILTIN_APPS=y
CONFIG_NSH_ROMFSETC=y
CONFIG_NSH_ARCHINIT=y

# NSH Library Configuration
CONFIG_NSH_DISABLEBG=y
CONFIG_NSH_FILEIOSIZE=512
CONFIG_NSH_CMDPARMSIZE=256
CONFIG_NSH_VARS=y

# LED and Button Configuration
CONFIG_USERLED_LOWER=y
CONFIG_USERSWITCH=y
```

## nuttx/boards/arm/stm32n6/stm32n6570-dk/Kconfig
```kconfig
#
# For a description of the syntax of this configuration file, see
# the file kconfig-language.txt in the NuttX tools repository.
#

if ARCH_BOARD_STM32N6570_DK

config STM32N6570_DK_BOARD
	bool
	default y

menu "STM32N6570-DK Peripheral Bring-up"

config STM32N6570_DK_I2C1
	bool "I2C1 CSI connector bring-up"
	default n
	depends on STM32N6_I2C1
	---help---
		Configure the STM32N6570-DK I2C1 pins used by the CSI
		connector and compile the NuttX I2C lower-half entry point.

config STM32N6570_DK_I2C2
	bool "I2C2 touch-controller bus bring-up"
	default n
	depends on STM32N6_I2C2
	---help---
		Configure the STM32N6570-DK I2C2 pins used by the GT911 touch
		controller and compile the NuttX I2C lower-half entry point.

config STM32N6570_DK_I2C4
	bool "I2C4 Arduino connector bring-up"
	default n
	depends on STM32N6_I2C4

config STM32N6570_DK_GT911
	bool "Goodix GT911 touch reset/IRQ pins"
	default n
	depends on STM32N6570_DK_I2C2
	---help---
		Configure the GT911 reset and interrupt GPIOs.  The GT911
		touchscreen driver binding is not claimed complete by this
		board option.

config STM32N6570_DK_SPI5
	bool "SPI5 Arduino connector bring-up"
	default n
	depends on STM32N6_SPI5

config STM32N6570_DK_FDCAN1
	bool "FDCAN1 bring-up"
	default n
	depends on STM32N6_FDCAN1

config STM32N6570_DK_SDMMC2
	bool "SDMMC2 microSD bring-up"
	default n
	depends on STM32N6_SDMMC2

config STM32N6570_DK_ADC1
	bool "ADC1 Arduino analog inputs"
	default n
	depends on STM32N6_ADC1

config STM32N6570_DK_TIM1_PWM
	bool "TIM1 channel 1 PWM bring-up"
	default n
	depends on STM32N6_TIM1_PWM

config STM32N6570_DK_TIM15_PWM
	bool "TIM15 channel 1 PWM bring-up"
	default n
	depends on STM32N6_TIM15_PWM

config STM32N6570_DK_ETH
	bool "Ethernet RGMII/MDIO bring-up"
	default n
	depends on STM32N6_ETH

config STM32N6570_DK_LTDC
	bool "LTDC RGB panel bring-up"
	default n
	depends on STM32N6_LTDC

config STM32N6570_DK_DISPLAY
	bool "Display power and backlight GPIOs"
	default n
	depends on STM32N6570_DK_LTDC

config STM32N6570_DK_XSPI1_PSRAM
	bool "XSPI1 APS256xxN PSRAM bring-up"
	default n
	depends on STM32N6_XSPI1
	---help---
		Configure the XSPI1 PSRAM pins and controller clock path.
		The PSRAM is not added to the heap or used for .data/.bss.

config STM32N6570_DK_XSPI2_FLASH
	bool "XSPI2 MX66UW1G45G NOR Flash registration"
	default y
	depends on STM32N6_XSPI2_FLASH
	---help---
		Register the XSPI2 MX66UW1G45G MTD as /dev/xspi2flash0 when
		the JEDEC probe succeeds.

endmenu

endif
```
