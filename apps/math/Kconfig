## apps/wing/base/Kconfig
```kconfig
config WING
	bool "Wing lightweight UI shell"
	default n
	select FHRE
	---help---
		Wing is the declarative shell/UI layer that sits above FHRE.  The
		project keeps parallel Rust and clang implementations.  The Rust
		implementation is the primary path for now.
```

## apps/wing/clang/Kconfig
```kconfig
config WING_CLANG
	bool "Wing clang implementation"
	default n
	depends on WING
	select FHRE_CLANG
	---help---
		Reserved for the parallel clang/C implementation of Wing.  The Rust
		implementation is currently the default path.
```

## apps/wing/rust/Kconfig
```kconfig
config WING_RUST
	bool "Wing Rust implementation"
	default y if WING
	depends on WING
	select FHRE_RUST
	---help---
		Build the primary Wing implementation as no_std Rust.  This is the
		current mainline implementation.
```

## nuttx/arch/arm/src/ra8p/Kconfig
```kconfig
#
# For a description of the syntax of this configuration file,
# see the file kconfig-language.txt in the NuttX tools repository.
#

comment "RA8P Configuration Options"

choice
	prompt "RA8P Chip Selection"
	default ARCH_CHIP_R7KA8P1KFLCAC
	depends on ARCH_CHIP_RA8P

config ARCH_CHIP_R7KA8P1KFLCAC
	bool "R7KA8P1KFLCAC (RA8P1)"
	select ARCH_CORTEXM85
	select ARCH_HAVE_FPU
	select ARCH_HAVE_MPU
	select ARM_HAVE_MPU_UNIFIED
	select ARM_HAVE_MVE
	select ARMV8M_HAVE_ICACHE
	select ARMV8M_HAVE_DCACHE
	select ARMV8M_SYSTICK
	help
	  Renesas RA8P1 Series (Cortex-M85)
	  - Up to 1 GHz ARM Cortex-M85
	  - ARMv8.1-M Mainline architecture
	  - DSP, MVE-F, FPU, I/D Cache
	  - Dual Core (CM85 + CM33)
	  - Optional Ethos-U55 NPU
	  - MIPI DSI/CSI support

endchoice # RA8P Chip Selection

config RA8P_DUAL_CORE
	bool "Enable dual-core support"
	default y if ARCH_CHIP_R7KA8P1KFLCAC
	depends on ARCH_CHIP_R7KA8P1KFLCAC
	help
	  Enable support for dual-core configuration (Cortex-M85 + Cortex-M33)

config RA8P_MIPI_DSI
	bool "Enable MIPI DSI support"
	default y if ARCH_CHIP_R7KA8P1KFLCAC
	depends on ARCH_CHIP_R7KA8P1KFLCAC
	help
	  Enable MIPI DSI/CSI display interface support

config RA8P_NPU_ETHOS_U55
	bool "Enable Ethos-U55 NPU support"
	default n
	depends on ARCH_CHIP_R7KA8P1KFLCAC
	help
	  Enable Arm Ethos-U55 NPU support for AI/ML operations

menu "RA8P Peripheral Support"

config RA8P_HAVE_SCI_B_UART
	bool
	default y

config RA8P_HAVE_SPI_B
	bool
	default y

config RA8P_HAVE_IIC
	bool
	default y

config RA8P_HAVE_GPT_PWM
	bool
	default y

config RA8P_HAVE_USBFS
	bool
	default y

config RA8P_HAVE_USBHS
	bool
	default y

config RA8P_HAVE_CANFD
	bool
	default y

config RA8P_HAVE_SDHC
	bool
	default y

config RA8P_HAVE_RTC
	bool
	default y

config RA8P_HAVE_WDT
	bool
	default y

config RA8P_HAVE_GLCDC
	bool
	default y

config RA8P_HAVE_MIPI_DSI
	bool
	default y if RA8P_MIPI_DSI
	default n

config RA8P_HAVE_I3C
	bool
	default y

config RA8P_HAVE_SDRAMC
	bool
	default y

config RA8P_HAVE_DMA
	bool
	default y

config RA8P_HAVE_NPU
	bool
	default y if RA8P_NPU_ETHOS_U55
	default n

comment "SCI_B UART Configuration"

config RA8P_SCI_B_UART0
	bool "SCI_B UART 0"
	default n
	depends on RA8P_HAVE_SCI_B_UART

config RA8P_SCI_B_UART1
	bool "SCI_B UART 1"
	default n
	depends on RA8P_HAVE_SCI_B_UART

config RA8P_SCI_B_UART2
	bool "SCI_B UART 2 (Default Console)"
	default y
	depends on RA8P_HAVE_SCI_B_UART

config RA8P_SCI_B_UART3
	bool "SCI_B UART 3"
	default n
	depends on RA8P_HAVE_SCI_B_UART

config RA8P_SCI_B_UART4
	bool "SCI_B UART 4"
	default n
	depends on RA8P_HAVE_SCI_B_UART

config RA8P_SCI_B_UART5
	bool "SCI_B UART 5"
	default n
	depends on RA8P_HAVE_SCI_B_UART

config RA8P_SCI_B_UART6
	bool "SCI_B UART 6"
	default n
	depends on RA8P_HAVE_SCI_B_UART

config RA8P_SCI_B_UART7
	bool "SCI_B UART 7"
	default n
	depends on RA8P_HAVE_SCI_B_UART

config RA8P_SCI_B_UART8
	bool "SCI_B UART 8"
	default n
	depends on RA8P_HAVE_SCI_B_UART

config RA8P_SCI_B_UART9
	bool "SCI_B UART 9"
	default n
	depends on RA8P_HAVE_SCI_B_UART

comment "SPI_B Configuration"

config RA8P_SPI_B0
	bool "SPI_B 0"
	default n
	depends on RA8P_HAVE_SPI_B

config RA8P_SPI_B1
	bool "SPI_B 1"
	default n
	depends on RA8P_HAVE_SPI_B

config RA8P_SPI_B2
	bool "SPI_B 2"
	default n
	depends on RA8P_HAVE_SPI_B

config RA8P_SPI_B3
	bool "SPI_B 3"
	default n
	depends on RA8P_HAVE_SPI_B

comment "IIC (I2C) Configuration"

config RA8P_IIC0
	bool "IIC 0"
	default n
	depends on RA8P_HAVE_IIC

config RA8P_IIC1
	bool "IIC 1"
	default n
	depends on RA8P_HAVE_IIC

config RA8P_IIC2
	bool "IIC 2"
	default n
	depends on RA8P_HAVE_IIC

comment "GPT PWM Configuration"

config RA8P_GPT_PWM0
	bool "GPT PWM 0"
	default n
	depends on RA8P_HAVE_GPT_PWM

config RA8P_GPT_PWM1
	bool "GPT PWM 1"
	default n
	depends on RA8P_HAVE_GPT_PWM

config RA8P_GPT_PWM2
	bool "GPT PWM 2"
	default n
	depends on RA8P_HAVE_GPT_PWM

config RA8P_GPT_PWM3
	bool "GPT PWM 3"
	default n
	depends on RA8P_HAVE_GPT_PWM

config RA8P_GPT_PWM4
	bool "GPT PWM 4"
	default n
	depends on RA8P_HAVE_GPT_PWM

config RA8P_GPT_PWM5
	bool "GPT PWM 5"
	default n
	depends on RA8P_HAVE_GPT_PWM

config RA8P_GPT_PWM6
	bool "GPT PWM 6"
	default n
	depends on RA8P_HAVE_GPT_PWM

config RA8P_GPT_PWM7
	bool "GPT PWM 7"
	default n
	depends on RA8P_HAVE_GPT_PWM

config RA8P_GPT_PWM8
	bool "GPT PWM 8"
	default n
	depends on RA8P_HAVE_GPT_PWM

config RA8P_GPT_PWM9
	bool "GPT PWM 9"
	default n
	depends on RA8P_HAVE_GPT_PWM

config RA8P_GPT_PWM10
	bool "GPT PWM 10"
	default n
	depends on RA8P_HAVE_GPT_PWM

config RA8P_GPT_PWM11
	bool "GPT PWM 11"
	default n
	depends on RA8P_HAVE_GPT_PWM

config RA8P_GPT_PWM12
	bool "GPT PWM 12"
	default n
	depends on RA8P_HAVE_GPT_PWM

config RA8P_GPT_PWM13
	bool "GPT PWM 13"
	default n
	depends on RA8P_HAVE_GPT_PWM

comment "USB Configuration"

config RA8P_USBFS
	bool "USB Full Speed"
	default n
	depends on RA8P_HAVE_USBFS

config RA8P_USBHS
	bool "USB High Speed"
	default n
	depends on RA8P_HAVE_USBHS

config RA8P_USBPHY
	bool "USBPHY Controller"
	default n
	help
	  Enable USBPHY support for both USBFS and USBHS controllers.

comment "CANFD Configuration"

config RA8P_CANFD0
	bool "CANFD 0"
	default n
	depends on RA8P_HAVE_CANFD

config RA8P_CANFD1
	bool "CANFD 1"
	default n
	depends on RA8P_HAVE_CANFD

comment "SDHC Configuration"

config RA8P_SDHC0
	bool "SDHC 0"
	default n
	depends on RA8P_HAVE_SDHC

config RA8P_SDHC1
	bool "SDHC 1"
	default n
	depends on RA8P_HAVE_SDHC

comment "CANFD Configuration"

config RA8P_CANFD0
	bool "CANFD 0"
	default n
	depends on RA8P_HAVE_CANFD

config RA8P_CANFD1
	bool "CANFD 1"
	default n
	depends on RA8P_HAVE_CANFD

comment "I3C Configuration"

config RA8P_I3C0
	bool "I3C 0"
	default n
	depends on RA8P_HAVE_I3C

comment "DMA Configuration"

config RA8P_DMA
	bool "DMA Controller"
	default n
	depends on RA8P_HAVE_DMA

config RA8P_DMA_CHANNELS
	int "Number of DMA channels"
	default 8
	depends on RA8P_DMA

comment "Display Configuration"

config RA8P_GLCDC
	bool "GLCDC Display Controller"
	default n
	depends on RA8P_HAVE_GLCDC

config RA8P_MIPI_DSI_DRIVER
	bool "MIPI DSI Driver"
	default n
	depends on RA8P_HAVE_MIPI_DSI

comment "RTC Configuration"

config RA8P_RTC
	bool "RTC"
	default n
	depends on RA8P_HAVE_RTC

comment "WDT Configuration"

config RA8P_WDT
	bool "Watchdog Timer"
	default n
	depends on RA8P_HAVE_WDT

comment "NPU Configuration"

config RA8P_NPU
	bool "Ethos-U55 NPU"
	default n
	depends on RA8P_HAVE_NPU

comment "ICU (External Interrupt) Configuration"

config RA8P_ICU
	bool "ICU External Interrupt Controller"
	default y
	help
	  Enable ICU (External Interrupt Controller) support for GPIO interrupts.

comment "I3C Configuration"

config RA8P_I3C0
	bool "I3C Controller 0"
	default n
	depends on RA8P_HAVE_I3C
	help
	  Enable I3C Controller 0 support.

comment "OSPI (Octal SPI) Configuration"

config RA8P_OSPI0
	bool "OSPI Controller 0"
	default n
	depends on ARCH_CHIP_R7KA8P1KFLCAC
	help
	  Enable OSPI (Octal SPI) Controller 0 support for external flash.

config RA8P_OSPI1
	bool "OSPI Controller 1"
	default n
	depends on ARCH_CHIP_R7KA8P1KFLCAC
	help
	  Enable OSPI (Octal SPI) Controller 1 support for external flash.

comment "Ethernet Configuration"

config RA8P_ETHERNET
	bool "Ethernet Controller (ETHERC/EDMAC)"
	default n
	depends on ARCH_CHIP_R7KA8P1KFLCAC
	help
	  Enable Ethernet controller support (ETHERC + EDMAC).

config RA8P_ETHERNET_PHY_ADDR
	int "PHY Address"
	default 0
	depends on RA8P_ETHERNET
	help
	  PHY address for Ethernet.

config RA8P_ETHERNET_RGMII
	bool "RGMII Mode"
	default n
	depends on RA8P_ETHERNET
	help
	  Enable RGMII mode for gigabit Ethernet.

comment "ADC Configuration"

config RA8P_ADC0
	bool "ADC Controller 0"
	default n
	depends on ARCH_CHIP_R7KA8P1KFLCAC
	help
	  Enable ADC Controller 0 support.

config RA8P_ADC_RESOLUTION
	int "ADC Resolution"
	default 12
	range 12 16
	depends on RA8P_ADC0
	help
	  ADC resolution in bits (12 or 16).

comment "DAC Configuration"

config RA8P_DAC0
	bool "DAC Controller 0"
	default n
	depends on ARCH_CHIP_R7KA8P1KFLCAC
	help
	  Enable DAC Controller 0 support.

comment "MIPI DSI Configuration"

config RA8P_MIPI_DSI
	bool "MIPI DSI Controller"
	default n
	depends on RA8P_MIPI_DSI
	help
	  Enable MIPI DSI display interface support.

config RA8P_MIPI_DSI_LANES
	int "Number of DSI Lanes"
	default 2
	range 1 4
	depends on RA8P_MIPI_DSI
	help
	  Number of MIPI DSI data lanes (1-4).

comment "Power Management Configuration"

config RA8P_POWER
	bool "Power Management"
	default y
	help
	  Enable power management support including sleep, standby, and deep standby modes.

endmenu # RA8P Peripheral Support

config RA8P_NR_IRQS
	int "Number of peripheral interrupts"
	default 96
	depends on ARCH_CHIP_RA8P

config RA8P_ROM_SIZE
	hex "Code MRAM/Flash size"
	default 0x100000
	depends on ARCH_CHIP_R7KA8P1KFLCAC
	help
	  Code MRAM and Flash size for RA8P1

config RA8P_PACKAGE_TYPE
	int "Package type"
	range 1 3
	default 2
	depends on ARCH_CHIP_R7KA8P1KFLCAC
	help
	  Package type:
	  1 -> AB: LFBGA 224 pins
	  2 -> AC: LFBGA 289 pins
	  3 -> AJ: LFBGA 303 pins

config RA8P_NUM_CORES
	int "Number of cores"
	range 1 2
	default 2
	depends on ARCH_CHIP_R7KA8P1KFLCAC
	help
	  Number of SoC cores (CM85 + CM33)
```
