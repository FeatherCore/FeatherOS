## nuttx/boards/arm/stm32n6/stm32n6570-dk/configs/full/defconfig
```kconfig
CONFIG_ARCH="arm"
CONFIG_ARCH_BOARD="stm32n6570-dk"
CONFIG_ARCH_BOARD_STM32N6570_DK=y
CONFIG_ARCH_CHIP="stm32n6"
CONFIG_ARCH_CHIP_STM32N6=y
CONFIG_ARCH_CHIP_STM32N657XX=y
CONFIG_ARCH_INTERRUPTSTACK=2048
CONFIG_ARCH_STACKDUMP=y
CONFIG_ARM_MPU=y
CONFIG_ARMV8M_DCACHE=y
CONFIG_ARMV8M_ICACHE=y
CONFIG_BINFMT_DISABLE=y
CONFIG_BOARDCTL=y
CONFIG_BOARD_LOOPSPERMSEC=64000
CONFIG_BUILTIN=y
CONFIG_DEV_CONSOLE=y
CONFIG_IDLETHREAD_STACKSIZE=2048
CONFIG_INIT_ENTRYPOINT="nsh_main"
CONFIG_INTELHEX_BINARY=y
CONFIG_LIBC_FLOATINGPOINT=y
CONFIG_LIBC_STRERROR=y
CONFIG_MTD=y
CONFIG_MTD_MX66UW=y
CONFIG_MX66UW_QSPI_FREQUENCY=24000000
CONFIG_NFILE_DESCRIPTORS=32
CONFIG_NFILE_STREAMS=16
CONFIG_NSH_ARCHINIT=y
CONFIG_NSH_BUILTIN_APPS=y
CONFIG_PREALLOC_TIMERS=4
CONFIG_RAM_SIZE=1048576
CONFIG_RAM_START=0x34000000
CONFIG_RAW_BINARY=y
CONFIG_RR_INTERVAL=200
CONFIG_SCHED_LPWORK=y
CONFIG_SCHED_WAITPID=y
CONFIG_SERIAL=y
CONFIG_START_DAY=1
CONFIG_START_MONTH=1
CONFIG_START_YEAR=2026
CONFIG_STM32N6_ADC1=y
CONFIG_STM32N6_AHB_PRESCALER=1
CONFIG_STM32N6_APB1_PRESCALER=1
CONFIG_STM32N6_APB2_PRESCALER=1
CONFIG_STM32N6_APB4_PRESCALER=1
CONFIG_STM32N6_APB5_PRESCALER=1
CONFIG_STM32N6_AXISRAM1=y
CONFIG_STM32N6_AXISRAM2=y
CONFIG_STM32N6_ETH=y
CONFIG_STM32N6_EXTI=y
CONFIG_STM32N6_FDCAN1=y
CONFIG_STM32N6_GPIO=y
CONFIG_STM32N6_HCLK_FREQUENCY=64000000
CONFIG_STM32N6_HSE_FREQUENCY=48000000
CONFIG_STM32N6_HSI_FREQUENCY=64000000
CONFIG_STM32N6_I2C1=y
CONFIG_STM32N6_I2C2=y
CONFIG_STM32N6_I2C4=y
CONFIG_STM32N6_LTDC=y
CONFIG_STM32N6_NPU=y
CONFIG_STM32N6_NPU_CACHE=y
CONFIG_STM32N6_RIF=y
CONFIG_STM32N6_RIF_OPEN=y
CONFIG_STM32N6_SDMMC2=y
CONFIG_STM32N6_SPI5=y
CONFIG_STM32N6_SYSCLK_FREQUENCY=64000000
CONFIG_STM32N6_TIM1_PWM=y
CONFIG_STM32N6_TIM15_PWM=y
CONFIG_STM32N6_TIMERS=y
CONFIG_STM32N6_USART1=y
CONFIG_STM32N6_USART2=y
CONFIG_STM32N6_USBOTGHS1=y
CONFIG_STM32N6_XSPI1=y
CONFIG_STM32N6_XSPI2=y
CONFIG_STM32N6_XSPI2_FLASH=y
CONFIG_STM32N6570_DK_ADC1=y
CONFIG_STM32N6570_DK_DISPLAY=y
CONFIG_STM32N6570_DK_ETH=y
CONFIG_STM32N6570_DK_FDCAN1=y
CONFIG_STM32N6570_DK_GT911=y
CONFIG_STM32N6570_DK_I2C1=y
CONFIG_STM32N6570_DK_I2C2=y
CONFIG_STM32N6570_DK_I2C4=y
CONFIG_STM32N6570_DK_LTDC=y
CONFIG_STM32N6570_DK_SDMMC2=y
CONFIG_STM32N6570_DK_SPI5=y
CONFIG_STM32N6570_DK_TIM1_PWM=y
CONFIG_STM32N6570_DK_TIM15_PWM=y
CONFIG_STM32N6570_DK_XSPI1_PSRAM=y
CONFIG_STM32N6570_DK_XSPI2_FLASH=y
CONFIG_SYSTEM_NSH=y
CONFIG_TIMER=y
CONFIG_USART1_BAUD=115200
CONFIG_USART1_BITS=8
CONFIG_USART1_PARITY=0
CONFIG_USART1_RXBUFSIZE=256
CONFIG_USART1_SERIAL_CONSOLE=y
CONFIG_USART1_TXBUFSIZE=256
CONFIG_USART2_BAUD=115200
CONFIG_USART2_BITS=8
CONFIG_USART2_PARITY=0
CONFIG_USART2_RXBUFSIZE=256
CONFIG_USART2_TXBUFSIZE=256
CONFIG_USEC_PER_TICK=1000
```

## nuttx/boards/arm/stm32n6/stm32n6570-dk/configs/nsh/defconfig
```kconfig
CONFIG_ARCH="arm"
CONFIG_ARCH_BOARD="stm32n6570-dk"
CONFIG_ARCH_BOARD_STM32N6570_DK=y
CONFIG_ARCH_CHIP="stm32n6"
CONFIG_ARCH_CHIP_STM32N6=y
CONFIG_ARCH_CHIP_STM32N657XX=y
CONFIG_ARCH_INTERRUPTSTACK=2048
CONFIG_ARCH_STACKDUMP=y
CONFIG_ARM_MPU=y
CONFIG_ARMV8M_DCACHE=y
CONFIG_ARMV8M_ICACHE=y
CONFIG_BINFMT_DISABLE=y
CONFIG_BOARD_LOOPSPERMSEC=64000
CONFIG_BUILTIN=y
CONFIG_DEV_CONSOLE=y
CONFIG_IDLETHREAD_STACKSIZE=2048
CONFIG_INIT_ENTRYPOINT="nsh_main"
CONFIG_INTELHEX_BINARY=y
CONFIG_LIBC_FLOATINGPOINT=y
CONFIG_LIBC_STRERROR=y
CONFIG_NFILE_DESCRIPTORS=32
CONFIG_NFILE_STREAMS=16
CONFIG_NSH_ARCHINIT=y
CONFIG_NSH_BUILTIN_APPS=y
CONFIG_PREALLOC_TIMERS=4
CONFIG_RAM_SIZE=1048576
CONFIG_RAM_START=0x34000000
CONFIG_RAW_BINARY=y
CONFIG_RR_INTERVAL=200
CONFIG_SCHED_WAITPID=y
CONFIG_SERIAL=y
CONFIG_START_DAY=1
CONFIG_START_MONTH=1
CONFIG_START_YEAR=2026
CONFIG_STM32N6_AHB_PRESCALER=1
CONFIG_STM32N6_APB1_PRESCALER=1
CONFIG_STM32N6_APB2_PRESCALER=1
CONFIG_STM32N6_APB4_PRESCALER=1
CONFIG_STM32N6_APB5_PRESCALER=1
CONFIG_STM32N6_AXISRAM1=y
CONFIG_STM32N6_AXISRAM2=y
CONFIG_STM32N6_EXTI=y
CONFIG_STM32N6_GPIO=y
CONFIG_STM32N6_HCLK_FREQUENCY=64000000
CONFIG_STM32N6_HSE_FREQUENCY=48000000
CONFIG_STM32N6_HSI_FREQUENCY=64000000
CONFIG_STM32N6_RIF=y
CONFIG_STM32N6_RIF_OPEN=y
CONFIG_STM32N6_SYSCLK_FREQUENCY=64000000
CONFIG_STM32N6_TIMERS=y
CONFIG_STM32N6_USART1=y
CONFIG_STM32N6_USART2=y
CONFIG_SYSTEM_NSH=y
CONFIG_TIMER=y
CONFIG_USART1_BAUD=115200
CONFIG_USART1_BITS=8
CONFIG_USART1_PARITY=0
CONFIG_USART1_RXBUFSIZE=256
CONFIG_USART1_SERIAL_CONSOLE=y
CONFIG_USART1_TXBUFSIZE=256
CONFIG_USART2_BAUD=115200
CONFIG_USART2_BITS=8
CONFIG_USART2_PARITY=0
CONFIG_USART2_RXBUFSIZE=256
CONFIG_USART2_TXBUFSIZE=256
CONFIG_USEC_PER_TICK=1000
```

## nuttx/boards/arm/stm32n6570-dk/nsh/defconfig
```kconfig
#
# STM32N6570-DK Board Configuration for FeatherOS/NuttX
#

CONFIG_ARCH_CHIP_STM32N657XX=y
CONFIG_ARCH_ARMV8M=y
CONFIG_ARCH_FPU=y
CONFIG_ARM_MPU=y

# System Clock Configuration
CONFIG_STM32N6_HSI_FREQUENCY=64000000
CONFIG_STM32N6_HSE_FREQUENCY=48000000
CONFIG_STM32N6_SYSCLK_FREQUENCY=64000000
CONFIG_STM32N6_AHB_PRESCALER=1
CONFIG_STM32N6_APB1_PRESCALER=1
CONFIG_STM32N6_APB2_PRESCALER=1
CONFIG_STM32N6_APB4_PRESCALER=1
CONFIG_STM32N6_APB5_PRESCALER=1
CONFIG_STM32N6_VOS_SCALE=SCALE0

# UART Configuration
CONFIG_STM32N6_UART=y
CONFIG_STM32N6_UART1=y
CONFIG_STM32N6_UART1_SERIALDRIVER=y
CONFIG_STM32N6_UART1_BAUD=115200
CONFIG_STM32N6_UART2=y
CONFIG_STM32N6_UART2_SERIALDRIVER=y
CONFIG_STM32N6_UART2_BAUD=115200

# GPIO Configuration
CONFIG_STM32N6_GPIO=y

# Timer Configuration
CONFIG_STM32N6_TIMERS=y

# EXTI Configuration
CONFIG_STM32N6_EXTI=y

# HSEM Configuration
CONFIG_STM32N6_HSEM=y

# NPU Configuration
CONFIG_STM32N6_NPU=y
CONFIG_STM32N6_NPU_CACHE=y

# RIF Configuration
CONFIG_STM32N6_RIF=y
CONFIG_STM32N6_RIF_OPEN=y

# Memory Configuration
CONFIG_STM32N6_AXISRAM1=y
CONFIG_STM32N6_AXISRAM2=y
CONFIG_STM32N6_AXISRAM3=n
CONFIG_STM32N6_AXISRAM4=n
CONFIG_STM32N6_AXISRAM5=n
CONFIG_STM32N6_AXISRAM6=n

# Cache Configuration
CONFIG_ARMV8M_DCACHE=y
CONFIG_ARMV8M_ICACHE=y

# Serial Driver
CONFIG_SERIAL=y
CONFIG_UART_SERIALDRIVER=y
CONFIG_SERIAL_CONSOLE=y

# System Configuration
CONFIG_IDLETHREAD_STACKSIZE=2048
CONFIG_SCHED_CPULOAD=y
CONFIG_USEC_PER_TICK=1000
CONFIG_SCHED_WORKQUEUE=y

# Debug Configuration
CONFIG_DEBUG_FEATURES=y
CONFIG_DEBUG_INFO=y
CONFIG_DEBUG_SYMBOLS=y
CONFIG_DEBUG_ERRORS=y
CONFIG_DEBUG_WARNINGS=y

# Build Configuration
CONFIG_BUILD_PROTECTED=n
CONFIG_NXFLAT=n
CONFIG_HAVE_RAMFUNCS=y
```

## nuttx/boards/arm/stm32u5/stm32u5a9j-dk/Kconfig
```kconfig
#
# For a description of the syntax of this configuration file,
# see the file kconfig-language.txt in the NuttX tools repository.
#

if ARCH_BOARD_STM32U5A9J_DK

comment "STM32U5A9J-DK LCD Configuration"

choice
	prompt "LCD Interface"
	default STM32U5A9J_DK_LCD_MIPI_DSI

config STM32U5A9J_DK_LCD_MIPI_DSI
	bool "MIPI DSI LCD"
	select STM32U5_LTDC
	select STM32U5_DSI
	---help---
		Enable support for the MIPI DSI LCD panel on the STM32U5A9J-DK.

config STM32U5A9J_DK_LCD_NONE
	bool "No LCD"
	---help---
		No LCD support.

endchoice

config STM32U5A9J_DK_LCD
	bool
	default y if STM32U5A9J_DK_LCD_MIPI_DSI

if STM32U5A9J_DK_LCD

config STM32U5A9J_DK_LCD_WIDTH
	int "LCD Width"
	default 480
	---help---
		LCD panel width in pixels.

config STM32U5A9J_DK_LCD_HEIGHT
	int "LCD Height"
	default 272
	---help---
		LCD panel height in pixels.

config STM32U5_LTDC_FB_BASE
	hex "LTDC Frame Buffer Base Address"
	default 0x90000000
	---help---
		Base address of the frame buffer in external memory (SDRAM).

config STM32U5_LTDC_FB_SIZE
	int "LTDC Frame Buffer Size"
	default 460800
	---help---
		Size of the frame buffer in bytes (480 * 480 * 2 for RGB565 = 460800).

choice
	prompt "LTDC Pixel Format"
	default STM32U5_LTDC_FMT_16RGB

config STM32U5_LTDC_FMT_16RGB
	bool "RGB565 (16-bit)"

config STM32U5_LTDC_FMT_24RGB
	bool "RGB888 (24-bit)"

endchoice

endif # STM32U5A9J_DK_LCD

comment "STM32U5A9J-DK Touchscreen Configuration"

config STM32U5A9J_DK_TOUCHSCREEN
	bool "Enable touchscreen support"
	default y if STM32U5A9J_DK_LCD
	select INPUT_FT5X06
	---help---
		Enable support for the FT5X06 touchscreen controller.

endif
```

## nuttx/configs/esp32_test_defconfig
```kconfig
# Minimal config for testing ESP32 WiFi driver compilation
# This enables the necessary options for ESP32 cfg80211 driver

# Architecture (use sim:fhre as base)
CONFIG_ARCH=sIM
CONFIG_ARCH_BOARD="sim:fhre"
CONFIG_ARCH_CHIP="sim"
CONFIG_ARCH_CHIP_SIM=y

# Basic OS features
CONFIG_SCHED_FFIFO=y
CONFIG_SCHED_HPWORK=y
CONFIG_PREALLOC_TIMERS=4
CONFIG_PTHREAD_MUTEX_TYPES=y
CONFIG_SIG_DEFAULT=y
CONFIG_START_DAY=6
CONFIG_START_MONTH=12
CONFIG_START_YEAR=2011

# Memory management
CONFIG_MM_REGIONS=1
CONFIG_MM_SMALL_ALLOC=y

# Console
CONFIG_UART0_SERIAL_CONSOLE=y
CONFIG_UART0_SERIAL_CONSOLE_DAYPRI=1
CONFIG_UART0_SERIAL_CONSOLE_DAYSIZ=256

# Networking
CONFIG_NET=y
CONFIG_NET_SKBUFFERS=1024
CONFIG_NET_ETH_PKTSIZE=1514
CONFIG_NET_TCP=y
CONFIG_NET_UDP=y
CONFIG_NET_ICMP_SOCKET=y
CONFIG_NET_DBUTILS_CJSON=y
CONFIG_NETUTILS_IPERF=y
CONFIG_NETDEV_LATEINIT=y
CONFIG_NETDEV_WIRELESS_IOCTL=y

# Wireless subsystem
CONFIG_WIRELESS=y
CONFIG_DRIVERS_WIRELESS=y
CONFIG_NL80211=y
CONFIG_NL80211_MAX_WIPHY=4
CONFIG_NL80211_MAX_INTERFACES=8
CONFIG_CFG80211=y
CONFIG_CFG80211_MAX_WIPHY=4
CONFIG_CFG80211_MAX_BSS=64
CONFIG_CFG80211_MAX_SCAN_REQUESTS=4

# ESP32 WiFi driver
CONFIG_ESP32_WIFI=y
CONFIG_ESP32_WIFI_SDIO=y
CONFIG_ESP32_WIFI_SPI=n
CONFIG_ESP32_WIFI_STA=y
CONFIG_ESP32_WIFI_AP=n
CONFIG_ESP32_WIFI_RESET_GPIO=-1
CONFIG_ESP32_WIFI_NINTERFACES=2
CONFIG_ESP32_WIFI_RX_BUFFER_SIZE=2048

# Debug
CONFIG_DEBUG_WIRELESS_INFO=y
CONFIG_DEBUG_WIRELESS_ERROR=y

# Filesystem
CONFIG_FS_PROCFS=y
CONFIG_FS_TMPFS=y

# Disable unused features to speed up compilation
# CONFIG_NSH_LIBRARY is not set
# CONFIG_ARCH_FPU is not set
```

## nuttx/drivers/wireless/esp32/Kconfig
```kconfig
# SPDX-License-Identifier: Apache-2.0

# ESP32 WiFi Driver Configuration

if WIRELESS && CFG80211

menu "ESP32 WiFi Driver"

config ESP32_WIFI
	bool "ESP32 WiFi support"
	default n
	help
	  Enable support for ESP32 WiFi chips via SDIO or SPI interface.
	  This provides cfg80211 compatibility layer for ESP32 chips.

if ESP32_WIFI

config ESP32_WIFI_SDIO
	bool "SDIO interface support"
	default y if ESP32_WIFI
	help
	  Enable SDIO interface for ESP32 WiFi chip communication.
	  
config ESP32_WIFI_SPI
	bool "SPI interface support"
	default n
	help
	  Enable SPI interface for ESP32 WiFi chip communication.

config ESP32_WIFI_STA
	bool "Station mode support"
	default y
	help
	  Enable station (client) mode support for connecting to APs.

config ESP32_WIFI_AP
	bool "Access Point mode support"
	default n
	help
	  Enable access point mode support for creating hotspots.

config ESP32_WIFI_P2P
	bool "Wi-Fi Direct (P2P) support"
	default n
	help
	  Enable Wi-Fi Direct (P2P) mode support.

config ESP32_WIFI_SDIO_DEVMINOR
	int "SDIO device minor number"
	default 0
	range 0 255
	depends on ESP32_WIFI_SDIO
	help
	  Minor number for the ESP32 SDIO device.

config ESP32_WIFI_SDIO_FUNCTION
	int "SDIO function number"
	default 1
	range 0 7
	depends on ESP32_WIFI_SDIO
	help
	  SDIO function number for ESP32 WiFi (typically 1).

config ESP32_WIFI_SPI_DEVMINOR
	int "SPI device minor number"
	default 0
	range 0 255
	depends on ESP32_WIFI_SPI
	help
	  Minor number for the ESP32 SPI device.

config ESP32_WIFI_SPI_INTR_PIN
	int "SPI interrupt GPIO pin"
	default -1
	range -1 255
	depends on ESP32_WIFI_SPI
	help
	  GPIO pin number for ESP32 SPI interrupt (-1 for none).

config ESP32_WIFI_SPI_CS_PIN
	int "SPI chip select GPIO pin"
	default 2
	range -1 255
	depends on ESP32_WIFI_SPI
	help
	  GPIO pin number for ESP32 SPI chip select (-1 for none).

config ESP32_WIFI_SPI_FREQ
	int "SPI frequency (Hz)"
	default 10000000
	range 1000000 40000000
	depends on ESP32_WIFI_SPI
	help
	  SPI clock frequency for ESP32 communication.

config ESP32_WIFI_NINTERFACES
	int "Maximum number of WiFi interfaces"
	default 2
	range 1 4
	help
	  Maximum number of WiFi interfaces (stations, APs) that can be created.

config ESP32_WIFI_RX_BUFFER_SIZE
	int "Receive buffer size"
	default 2048
	range 1024 8192
	help
	  Size of the receive buffer for ESP32 communication.

config ESP32_WIFI_SCAN_TIMEOUT
	int "Scan timeout (seconds)"
	default 10
	range 5 60
	help
	  Timeout for WiFi scan operations.

config ESP32_WIFI_CONNECT_TIMEOUT
	int "Connection timeout (seconds)"
	default 15
	range 5 60
	help
	  Timeout for WiFi connection attempts.

config ESP32_WIFI_DEBUG
	bool "ESP32 WiFi debugging"
	default n
	help
	  Enable debugging output for ESP32 WiFi driver.

if ESP32_WIFI_DEBUG

config ESP32_WIFI_DEBUG_INFO
	bool "Debug info output"
	default n
	help
	  Enable info-level debug output.

config ESP32_WIFI_DEBUG_ERROR
	bool "Debug error output"
	default y
	help
	  Enable error-level debug output.

endif # ESP32_WIFI_DEBUG

endif # ESP32_WIFI

endmenu

endif # WIRELESS && CFG80211
```

## nuttx/net/wireless/Kconfig
```kconfig
#
# For a description of the syntax of this configuration file,
# see the file kconfig-language.txt in the NuttX tools repository.
#

menu "Wireless Subsystem"

if WIRELESS

config NL80211
	bool "nl80211 wireless configuration interface"
	default n
	depends on NET_NETLINK && NETLINK_GENERIC
	---help---
		Enable nl80211 wireless configuration interface.
		This provides a Linux-compatible netlink interface for
		802.11 wireless configuration.

		This is required for wpa_supplicant and hostapd support.

config NL80211_MAX_WIPHY
	int "Maximum number of wiphy devices"
	default 4
	depends on NL80211
	---help---
		Maximum number of wiphy (wireless physical) devices
		that can be registered with nl80211.

config NL80211_MAX_INTERFACES
	int "Maximum number of wireless interfaces"
	default 8
	depends on NL80211
	---help---
		Maximum number of wireless interfaces that can be
		registered with nl80211.

config CFG80211
	bool "cfg80211 wireless configuration API"
	default n
	depends on NL80211
	---help---
		Enable cfg80211 wireless configuration API.
		This provides a standardized driver interface for
		802.11 wireless hardware.

		WiFi drivers should implement cfg80211_ops to work
		with this interface.

config CFG80211_MAX_WIPHY
	int "Maximum number of wiphy devices for cfg80211"
	default 4
	depends on CFG80211
	---help---
		Maximum number of wiphy devices that can be registered
		with cfg80211.

config CFG80211_MAX_BSS
	int "Maximum BSS entries in cache"
	default 64
	depends on CFG80211
	---help---
		Maximum number of BSS (Basic Service Set) entries
		that can be cached by cfg80211.

config CFG80211_MAX_SCAN_REQUESTS
	int "Maximum pending scan requests"
	default 4
	depends on CFG80211
	---help---
		Maximum number of pending scan requests.

config CFG80211_REGULATORY
	bool "cfg80211 regulatory domain support"
	default y
	depends on CFG80211
	---help---
		Enable regulatory domain management in cfg80211.
		This allows proper handling of channel restrictions
		based on regulatory requirements.

config CFG80211_DEFAULT_REGDOMAIN
	string "Default regulatory domain"
	default "00"
	depends on CFG80211_REGULATORY
	---help---
		Default regulatory domain (ISO 3166-1 alpha-2).
		Use "00" for world regulatory domain.

config CFG80211_DEBUG
	bool "cfg80211 debugging"
	default n
	depends on CFG80211 && DEBUG_WIRELESS_INFO
	---help---
		Enable debugging output for cfg80211.

config CFG80211_VERBOSE_DEBUG
	bool "cfg80211 verbose debugging"
	default n
	depends on CFG80211_DEBUG
	---help---
		Enable verbose debugging output for cfg80211.

endif # WIRELESS

endmenu # Wireless Subsystem
```
